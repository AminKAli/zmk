#include <behaviors.dtsi>
#include <dt-bindings/zmk/keys.h>

/* Uncomment this block if using an encoder */
//&encoder {
//    status = "okay";
//};

/ {
    keymap {
        compatible = "zmk,keymap";

        default_layer {
            bindings = < &kp Z >;
        };

        // lower {
        //     bindings = <
        //         &kp O
        //     >;
        // };

        // raise {
        //     bindings = <
        //         &kp O
        //     >;
        // };
    };
};
