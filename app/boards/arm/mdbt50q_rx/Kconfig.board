## app/boards/arm/mdbt50q_rx/Kconfig.defconfig
```kconfig
if BOARD_MDBT50Q_RX

config ZMK_KEYBOARD_NAME
    default "MDBT50Q-RX"

if USB_DEVICE_STACK

config USB_NRFX
    default y

endif # USB_DEVICE_STACK

config BT_CTLR
    default BT

endif # BOARD_MDBT50Q_RX
```

## app/boards/arm/mdbt50q_rx/mdbt50q_rx_defconfig
```kconfig
CONFIG_SOC_SERIES_NRF52X=y
CONFIG_SOC_NRF52840_QIAA=y
CONFIG_BOARD_MDBT50Q_RX=y

# Enable MPU
CONFIG_ARM_MPU=y

CONFIG_PINCTRL=y

# enable GPIO
CONFIG_GPIO=y

CONFIG_USE_DT_CODE_PARTITION=y
CONFIG_BUILD_OUTPUT_UF2=y

CONFIG_SETTINGS=y
CONFIG_INPUT=y

CONFIG_MPU_ALLOW_FLASH_WRITE=y
CONFIG_NVS=y
CONFIG_SETTINGS_NVS=y
CONFIG_FLASH=y
CONFIG_FLASH_PAGE_LAYOUT=y
CONFIG_FLASH_MAP=y

CONFIG_ZMK_ESB=n  # Set to y to enable ESB protocol
CONFIG_ZMK_ESB_RECEIVER=y # Set to 'y' to build a receiver(central) image and 'n' to build a transmitter(peripheral) 
CONFIG_ESB_FAST_RAMP_UP=n
CONFIG_ZMK_ESB_DYNAMIC_PAYLOAD=n

CONFIG_ZMK_BLE=n  # Set to 'y' to enable BLE
CONFIG_ZMK_SPLIT_LLPM=y # Set to 'y' to enable LLPM 1ms protocol
CONFIG_ZMK_SPLIT_ROLE_CENTRAL=y # Set to 'y' to build a central image and 'n' to build a peripheral
CONFIG_ZMK_SPLIT=y

CONFIG_ZMK_KSCAN_DEBOUNCE_PRESS_MS=0
CONFIG_ZMK_KSCAN_DEBOUNCE_RELEASE_MS=5
```

## app/boards/arm/nice_nano/nice_nano_v2_defconfig
```kconfig
# SPDX-License-Identifier: MIT

CONFIG_SOC_SERIES_NRF52X=y
CONFIG_SOC_NRF52840_QIAA=y
CONFIG_BOARD_NICE_NANO_V2=y

# Enable MPU
CONFIG_ARM_MPU=y

# Use pinctrl
CONFIG_PINCTRL=y

# enable GPIO
CONFIG_GPIO=y

CONFIG_USE_DT_CODE_PARTITION=y
CONFIG_BUILD_OUTPUT_UF2=y

CONFIG_MPU_ALLOW_FLASH_WRITE=y
CONFIG_NVS=y
CONFIG_SETTINGS_NVS=y
CONFIG_FLASH=y
CONFIG_FLASH_PAGE_LAYOUT=y
CONFIG_FLASH_MAP=y

# CONFIG_ZMK_USB=y
# # CONFIG_USB_DEVICE_STACK=y

# CONFIG_ZMK_ESB=n  # Set to y to enable ESB protocol
# # CONFIG_ZMK_ESB_RECEIVER=n # Set to 'y' to build a receiver(central) image and 'n' to build a transmitter(peripheral) 
# # CONFIG_ESB_FAST_RAMP_UP=n
# # CONFIG_ZMK_ESB_DYNAMIC_PAYLOAD=y
# # CONFIG_ZMK_ESB_REDUCE_CONSUMPTION=y

# CONFIG_ZMK_GAZELL=n
# # CONFIG_ZMK_GAZELL_RECEIVER=n

# CONFIG_ZMK_BLE=n  # Set to 'y' to enable BLE
# # CONFIG_ZMK_SPLIT_LLPM=n  # Set to 'y' to enable LLPM 1ms protocol
# # CONFIG_ZMK_SPLIT_ROLE_CENTRAL=n  # Set to 'y' to build a central image and 'n' to build a peripheral
# # CONFIG_ZMK_SPLIT=y

# # CONFIG_ZMK_KSCAN_DEBOUNCE_PRESS_MS=0
# # CONFIG_ZMK_KSCAN_DEBOUNCE_RELEASE_MS=5

# CONFIG_ZMK_EXT_POWER=n
```

## app/boards/arm/xiao_ble/xiao_ble_defconfig
```kconfig
# SPDX-License-Identifier: Apache-2.0

CONFIG_SOC_SERIES_NRF52X=y
CONFIG_SOC_NRF52840_QIAA=y
CONFIG_BOARD_XIAO_BLE=y

# Enable MPU
CONFIG_ARM_MPU=y

# Enable hardware stack protection
CONFIG_HW_STACK_PROTECTION=y

# enable GPIO
CONFIG_GPIO=y

# enable uart driver
CONFIG_SERIAL=y

# enable console
CONFIG_CONSOLE=y

# Logger cannot use itself to log
CONFIG_USB_CDC_ACM_LOG_LEVEL_OFF=y

# enable USB
CONFIG_USB_DEVICE_STACK=y

# Build UF2 by default, supported by the Adafruit nRF52 Bootloader
CONFIG_BUILD_OUTPUT_UF2=y
CONFIG_USE_DT_CODE_PARTITION=y


CONFIG_MPU_ALLOW_FLASH_WRITE=y
CONFIG_NVS=y
CONFIG_SETTINGS_NVS=y
CONFIG_FLASH=y
CONFIG_FLASH_PAGE_LAYOUT=y
CONFIG_FLASH_MAP=y

CONFIG_ZMK_ESB=n  # Set to y to enable ESB protocol
CONFIG_ZMK_ESB_RECEIVER=n # Set to 'y' to build a receiver(central) image and 'n' to build a transmitter(peripheral) 
CONFIG_ESB_FAST_RAMP_UP=n
CONFIG_ZMK_ESB_DYNAMIC_PAYLOAD=n
CONFIG_ZMK_ESB_REDUCE_CONSUMPTION=n

CONFIG_ZMK_BLE=n  # Set to 'y' to enable BLE
CONFIG_ZMK_SPLIT_LLPM=n  # Set to 'y' to enable LLPM 1ms protocol
CONFIG_ZMK_SPLIT_ROLE_CENTRAL=n  # Set to 'y' to build a central image and 'n' to build a peripheral
CONFIG_ZMK_SPLIT=y

CONFIG_ZMK_KSCAN_DEBOUNCE_PRESS_MS=0
CONFIG_ZMK_KSCAN_DEBOUNCE_RELEASE_MS=5

CONFIG_SERIAL=n
CONFIG_CONSOLE=n
CONFIG_LOG=n
CONFIG_UART_CONSOLE=n
```

## app/src/esb/Kconfig
```kconfig
menuconfig ZMK_ESB
    bool "Enable use of ESB for ZMK communication"
    default y
    select ESB

if ZMK_ESB

config ZMK_ESB_RECEIVER
    bool "Set this device as an ESB Receiver"
    default n
    select ZMK_USB

config ZMK_ESB_SECRET
    string "Secret key that all grouped devices need to know"

config ZMK_ESB_KEY
    string "Encryption key to encrypt all communiations between grouped devices"

config ESB_FAST_RAMP_UP
    bool "Enable fast switching when both ends are nrf52 or nrf53 devices"
    default n
    
config ZMK_ESB_DYNAMIC_PAYLOAD
    bool "Allow dynamic payload size"
    default n

config ZMK_ESB_REDUCE_CONSUMPTION
    bool "Puts the HFClock to sleep to reduce power in exchange for increased latency"
    default n
    select COUNTER

if ZMK_ESB_RECEIVER

config ZMK_ESB_TRANSMITTERS_COUNT
    int "Number of ESB transmitter devices"
    default 1

endif # ZMK_ESB_RECEIVER

endif #ZMK_ESB
```

## app/src/gazell/Kconfig
```kconfig
menuconfig ZMK_GAZELL
    bool "Enable use of Gazell for ZMK communication"
    default y
    select GZLL
    select CLOCK_CONTROL_NRF
    select GAZELL

if ZMK_GAZELL

config ZMK_GAZELL_RECEIVER
    bool "Set this device as an Gazell Receiver"
    default n
    select ZMK_USB

if ZMK_GAZELL_RECEIVER

config ZMK_GAZELL_TRANSMITTERS_COUNT
    int "Number of Gazell transmitter devices"
    default 1

endif # ZMK_GAZELL_RECEIVER

endif #ZMK_GAZELL
```
